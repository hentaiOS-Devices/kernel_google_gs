// SPDX-License-Identifier: (GPL-2.0 OR MIT)
/*
 * Copyright (C) 2021 MediaTek Inc.
 */
/dts-v1/;
#include "mt8195-cherry.dtsi"
#include "mt8195-tomato.dtsi"

/ {
	model = "MediaTek Tomato board";
	compatible = "google,tomato-rev3", "google,tomato", "mediatek,mt8195";
};

&sound {
	compatible = "mediatek,mt8195_mt6359_rt1019_rt5682";
	model = "m8195_r1019_5682s";
	mediatek,dptx-codec = <&dp_tx>;
};

&rt1019p {
	status = "okay";
};

&rt5682s {
	status = "okay";
};
