// SPDX-License-Identifier: (GPL-2.0 OR MIT)
/*
 * Copyright (C) 2021 MediaTek Inc.
 */
/dts-v1/;
#include "mt8195-cherry.dtsi"
#include "mt8195-tomato.dtsi"

/ {
	model = "MediaTek Tomato board";
	compatible = "google,tomato-rev2", "google,tomato", "mediatek,mt8195";
};
